## custom/package/quirc/Config.in
```kconfig
config BR2_PACKAGE_QUIRC
	bool "quirc"
	select BR2_PACKAGE_JPEG
	help
	  QR scanner

	  https://github.com/dlbeer/quirc.git
```

## custom/package/thingino-button/Config.in
```kconfig
config BR2_PACKAGE_THINGINO_BUTTON
	bool "thingino-button"
	select BR2_PACKAGE_THINGINO_JCT
	depends on BR2_USE_MMU # fork()
	help
	  Minimal daemon to monitor and execute commands vis button events
```
